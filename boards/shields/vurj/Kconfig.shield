## boards/shields/vurj/Kconfig.shield
```kconfig
# Copyright (c) 2020 The ZMK Contributors
# SPDX-License-Identifier: MIT

config SHIELD_VURJ_LEFT
	def_bool $(shields_list_contains,vurj_left)

config SHIELD_VURJ_RIGHT
	def_bool $(shields_list_contains,vurj_right)
```

## config/boards/shields/vurj-board/Kconfig.defconfig
```kconfig
# Copyright (c) 2020 The ZMK Contributors
# SPDX-License-Identifier: MIT

if SHIELD_VURJ_LEFT

config ZMK_KEYBOARD_NAME
	default "Vurj"

config ZMK_SPLIT_BLE_ROLE_CENTRAL
	default y

endif

if SHIELD_VURJ_LEFT || SHIELD_VURJ_RIGHT

config ZMK_SPLIT
	default y

endif
```
